## meta-my-extend/conf/layer.conf
```bitbake
# We have a conf and classes directory, add to BBPATH
BBPATH .= ":${LAYERDIR}"

# We have recipes-* directories, add to BBFILES
BBFILES += "${LAYERDIR}/recipes-*/*/*.bb \
            ${LAYERDIR}/recipes-*/*/*.bbappend"

BBFILE_COLLECTIONS += "meta-my-extend"
BBFILE_PATTERN_meta-my-extend = "^${LAYERDIR}/"
BBFILE_PRIORITY_meta-my-extend = "6"

LAYERDEPENDS_meta-my-extend = "core"
LAYERSERIES_COMPAT_meta-my-extend = "dunfell"
```

## meta-my/conf/layer.conf
```bitbake
# We have a conf and classes directory, add to BBPATH
BBPATH .= ":${LAYERDIR}"

# We have recipes-* directories, add to BBFILES
BBFILES += "${LAYERDIR}/recipes-*/*/*.bb \
            ${LAYERDIR}/recipes-*/*/*.bbappend"

BBFILE_COLLECTIONS += "meta-my"
BBFILE_PATTERN_meta-my = "^${LAYERDIR}/"
BBFILE_PRIORITY_meta-my = "6"

LAYERDEPENDS_meta-my = "core"
LAYERSERIES_COMPAT_meta-my = "dunfell"
```

## meta-my/conf/machine/rasp3-64-custom.conf
```bitbake
# Tái sử dụng cấu hình cơ bản và tuning CPU từ Raspberry Pi 3 64-bit
require conf/machine/include/rpi-base.inc
require conf/machine/include/tune-cortexa53.inc

# Đặt tên máy mới
MACHINEOVERRIDES = "rasp3-64-custom:raspberrypi3-64:"

# Thêm hoặc ghi đè các tính năng máy đặc trưng cho board bạn
MACHINE_FEATURES += "wifi bluetooth"

# Chỉ định device tree riêng cho board bạn
KERNEL_DEVICETREE = "broadcom/bcm2710-rpi-3-b-plus.dtb"

# Tùy chỉnh kernel image type nếu cần (ví dụ Image, zImage, uImage...)
KERNEL_IMAGETYPE = "Image"

# Gợi ý cho Yocto cấu hình serial console và getty // Lưu ý là cái boot bên mình cấu hình thế này. Nếu cấu hình khác là dễ dẫn đến sai hiển thị, màn hình bị đứng
SERIAL_CONSOLE = "115200 ttyS0" 
```

## meta-my/recipes-kernel/my-pcf857x/files/Kconfig
```kconfig
config MY_PCF857X
    tristate "My PCF857x driver"
    default m
    help
      Enable support for My PCF857x GPIO expander driver.
```

## meta-test/conf/layer.conf
```bitbake
# Layer configuration for meta-test

BBPATH .= ":${LAYERDIR}"
BBFILES += "${LAYERDIR}/recipes-*/*/*.bb \
            ${LAYERDIR}/recipes-*/*/*.bbappend"

BBFILE_COLLECTIONS += "meta-test"
BBFILE_PATTERN_meta-test := "^${LAYERDIR}/"
BBFILE_PRIORITY_meta-test = "8"


LAYERSERIES_COMPAT_meta-test = "dunfell gatesgarth hardknott honister kirkstone langdale mickledore nanbield scarthgap"

# Optional: Additional machine overrides
# MACHINEOVERRIDES .= ":test"

# Optional: Automatically include machine config fragments (if any)
# KERNEL_EXTRA_FEATURES += "features/test/uart.cfg"

IMAGE_INSTALL:append = " firmware-ath6k"
```
